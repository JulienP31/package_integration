## buildroot/Config.in
```kconfig
menu "Examples"
	source "$BR2_EXTERNAL_MYEXTERNAL_PATH/package/bar/Config.in"
	source "$BR2_EXTERNAL_MYEXTERNAL_PATH/package/libfoo/Config.in"
	source "$BR2_EXTERNAL_MYEXTERNAL_PATH/package/myapp/Config.in"
	source "$BR2_EXTERNAL_MYEXTERNAL_PATH/package/pressurelogger/Config.in"
endmenu
```

## buildroot/package/pressurelogger/Config.in
```kconfig
config BR2_PACKAGE_PRESSURELOGGER
	bool "pressurelogger"
	help
	  pressure logger host

	  ${HOME}/pressure_logger/host
```

## yocto/build/conf/bblayers.conf
```bitbake
# POKY_BBLAYERS_CONF_VERSION is increased each time build/conf/bblayers.conf
# changes incompatibly
POKY_BBLAYERS_CONF_VERSION = "2"

BBPATH = "${TOPDIR}"
BBFILES ?= ""

BBLAYERS ?= " \
  /home/julien/yocto-labs/poky/meta \
  /home/julien/yocto-labs/poky/meta-poky \
  /home/julien/yocto-labs/meta-ti \
  /home/julien/yocto-labs/meta-bootlinlabs \
  "
```
